## config/boards/shields/bethirty_ortho/Kconfig.defconfig
```kconfig
if SHIELD_BETHIRTY_ORTHO

config ZMK_KEYBOARD_NAME
    default "BeThirty O39"

endif
```

## config/boards/shields/bethirty_ortho/Kconfig.shield
```kconfig
config SHIELD_BETHIRTY_ORTHO
    def_bool $(shields_list_contains,bethirty_ortho)
```
